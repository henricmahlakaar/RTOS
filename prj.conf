## CMakeLists.txt
```
cmake_minimum_required(VERSION 3.20.0)
find_package(Zephyr REQUIRED HINTS $ENV{ZEPHYR_BASE})

project(RTOS)

target_sources(app PRIVATE src/main.c)
```

## prj.conf
```kconfig
CONFIG_GPIO=y
CONFIG_SERIAL=y
CONFIG_TIMING_FUNCTIONS=y
CONFIG_HEAP_MEM_POOL_SIZE=1024
```

## src/main.c
```c
#include <zephyr/kernel.h>
#include <zephyr/sys/printk.h>
#include <zephyr/device.h>
#include <zephyr/drivers/gpio.h>
#include <zephyr/drivers/uart.h>
#include <zephyr/timing/timing.h>
#include <stdlib.h>
#include <string.h>

/*
6vk tehtävä

Tavoiteltu pistemäärä: 2p
Perustelu:
- Robot Framework lähettää aikamerkkijonoja UARTiin.
- Testataan oikea aikamerkkijono.
- Testataan virheellinen sekuntiarvo.
- Testataan väärä pituus.
- Testataan virheellinen tuntiarvo.
- Testataan virheellinen minuuttiarvo.
- Testataan maksimi sallittu aika.

Tekijät:
Henric M. ja Jere K.
*/

// Defines
#define STACKSIZE 500
#define PRIORITY 5
#define UART_DEVICE_NODE DT_CHOSEN(zephyr_shell_uart)
//#define DEBUG
#define LINE_BUF_SIZE 32
#define ALARM_LED_ON_MS 500

#define TIME_LEN_ERROR -1
#define TIME_ARRAY_ERROR -2
#define TIME_VALUE_ERROR -3


// Ledit
static const struct gpio_dt_spec red   = GPIO_DT_SPEC_GET(DT_ALIAS(led0), gpios);
static const struct gpio_dt_spec green = GPIO_DT_SPEC_GET(DT_ALIAS(led1), gpios);
static const struct gpio_dt_spec blue  = GPIO_DT_SPEC_GET(DT_ALIAS(led2), gpios);
static const struct device *const uart_dev = DEVICE_DT_GET(UART_DEVICE_NODE);

// Taskit
void red_led_task(void *, void *, void *);
void yellow_led_task(void *, void *, void *);
void green_led_task(void *, void *, void *);
static void uart_task(void *, void *, void *);
static void dispatcher_task(void *, void *, void *);
static void alarm_off_handler(struct k_timer *timer);
static void alarm_handler(struct k_timer *timer);

// Threadit
K_THREAD_DEFINE(red_thread, STACKSIZE, red_led_task,    NULL, NULL, NULL, PRIORITY, 0, 0);
K_THREAD_DEFINE(yellow_thread, STACKSIZE, yellow_led_task, NULL, NULL, NULL, PRIORITY, 0, 0);
K_THREAD_DEFINE(green_thread, STACKSIZE, green_led_task,  NULL, NULL, NULL, PRIORITY, 0, 0);
K_THREAD_DEFINE(uart_thread, STACKSIZE, uart_task,       NULL, NULL, NULL, PRIORITY, 0, 0);
K_THREAD_DEFINE(dispatcher_thread, STACKSIZE, dispatcher_task, NULL, NULL, NULL, PRIORITY, 0, 0);
K_TIMER_DEFINE(alarm_off_timer, alarm_off_handler, NULL);
K_TIMER_DEFINE(alarm_timer, alarm_handler, NULL);

K_SEM_DEFINE(red_sem, 0,1);
K_SEM_DEFINE(yellow_sem, 0,1);
K_SEM_DEFINE(green_sem, 0,1);
K_SEM_DEFINE(done_sem, 0,1);

// FIFO-puskuri vastaanotetulle sekvenssille
K_FIFO_DEFINE(data_fifo);

static uint64_t sequence_total = 0;

// Aika sekvenssin käsittelyyn
int time_parse(char *time) {
 
	// how many seconds, default returns error
	int seconds = TIME_LEN_ERROR;
 
	// Check that string is not null
	if (time == NULL) {
		return TIME_ARRAY_ERROR;
	}
	// Tarkistaa että merkkijonon pituus on 6 merkkiä (hhmmss)
	if (strlen(time) != 6) {
		return TIME_LEN_ERROR;
	}
 
	// Parse values from time string
	// For example: 124033 -> 12hour 40min 33sec
	int values[3];
	values[2] = atoi(time+4); // seconds
	time[4] = 0;
	values[1] = atoi(time+2); // minutes
	time[2] = 0;
	values[0] = atoi(time); // hours
 
	// Boundary check: below zero or above limit not allowed
	if (values[0] < 0 || values[0] > 23 ||
		values[1] < 0 || values[1] > 59 ||
		values[2] < 0 || values[2] > 59) {
		return TIME_VALUE_ERROR;
	}
 
	seconds = values[0] * 3600 + values[1] * 60 + values[2];
 
	return seconds;
}

static void alarm_off_handler(struct k_timer *timer)
{
	gpio_pin_set_dt(&red, 0);
}

static void alarm_handler(struct k_timer *timer)
{
	printk("Timer interrupt: red on\n");
	gpio_pin_set_dt(&red, 1);
	k_timer_start(&alarm_off_timer, K_MSEC(ALARM_LED_ON_MS), K_NO_WAIT);
}


// FIFO:n datatyyppi
struct data_t {
	void *fifo_reserved;
	char color;
};

//Alustukset
 
int init_uart(void)
{
	if (!device_is_ready(uart_dev)) {
		return 1;
	}
	return 0;
}

int init_led(void)
{
	
	int ret = gpio_pin_configure_dt(&red, GPIO_OUTPUT_ACTIVE);
	ret |= gpio_pin_configure_dt(&blue, GPIO_OUTPUT_ACTIVE);
	ret |= gpio_pin_configure_dt(&green, GPIO_OUTPUT_ACTIVE);

	if (ret < 0) {
		printk("Error: Led configure failed\n");
		return ret;
	}

	
	gpio_pin_set_dt(&red, 0);
	gpio_pin_set_dt(&blue, 0);
	gpio_pin_set_dt(&green, 0);

	printk("Led initialized ok\n");

	return 0;
}

void add_sequence_time(uint64_t task_ns) {
	sequence_total += task_ns;
}

void print_sequence_time(void) {
	printk("Total sequence time: %lld.%03lld ms\n", sequence_total / 1000000, sequence_total % 1000000 / 1000);
	sequence_total = 0;
}
// Käsittelee yhden Enterillä päätetyn rivin
static void handle_line(char *line)
{
	if ((line[0] >= '0' && line[0] <= '9') || line[0] == '-') {
		// Aikamerkkijono -> parseri -> ajastin
		printk("Time string received: %s\n", line);
		printk("LEN=%d\n", strlen(line));
		printk("DATA='%s'\n", line);

		int sec = time_parse(line);
		printk("%d\n", sec);

		if (sec >= 0) {
    	k_timer_start(&alarm_timer, K_SECONDS(sec), K_NO_WAIT);
		} else {
			printk("Time parse error: %d\n", sec);
		}
	} else {
		// Liikennevalosekvenssi
		for (int i = 0; line[i] != '\0'; i++) {
			char c = line[i];
			if (c == 'R' || c == 'Y' || c == 'G') {
				struct data_t *data = k_malloc(sizeof(struct data_t));
				if (data == NULL) {
					printk("Malloc failed\n");
					return;
				}
				data->color = c;
				k_fifo_put(&data_fifo, data);
				printk("Data sent to fifo: %c\n", c);
			} else {
				printk("Unknown char: %c\n", c);
			}
		}
	}
}

// UART taski
static void uart_task(void *, void *, void *)
{
	char c = 0;
	char line[LINE_BUF_SIZE];
	int len = 0;

	printk("Uart thread started\n");
	while (true) {
		if (uart_poll_in(uart_dev, &c) == 0) {
			if (c == '\r' || c == '\n') {
				if (len > 0) {
					line[len] = '\0';
					printk("\n");
					handle_line(line);
					len = 0;
				}
			} else if (len < LINE_BUF_SIZE - 1) {
				line[len++] = c;
				uart_poll_out(uart_dev, c);
			}
		}
		k_msleep(10);
	}
}

static void dispatcher_task(void *, void *, void *)
{
	printk("Dispatcher thread started\n");
	while (true) {
		struct data_t *data = k_fifo_get(&data_fifo, K_FOREVER);
		if (data != NULL) {
			switch (data->color) {
				case 'R':
					k_sem_give(&red_sem);
					break;
				case 'Y':
					k_sem_give(&yellow_sem);
					break;
				case 'G':
					k_sem_give(&green_sem);
					break;
				default:
					printk("Unknown color: %c\n", data->color);
					break;
			}
			k_free(data);
			k_sem_take(&done_sem, K_FOREVER); 
			if (k_fifo_is_empty(&data_fifo)) {
				print_sequence_time();
			}
		}
	}
}

//Led taskit
void red_led_task(void *, void *, void *)
{
	printk("Red led thread started\n");
	while (true) {
		k_sem_take(&red_sem, K_FOREVER);
		timing_start();
		timing_t red_start_time = timing_counter_get();
		gpio_pin_set_dt(&red, 1);
		printk("Red on\n");
		k_sleep(K_SECONDS(1));

		gpio_pin_set_dt(&red, 0);
		printk("Red off\n");
		k_sem_give(&done_sem); 

		timing_t red_end_time = timing_counter_get();
		timing_stop();
		uint64_t timing_ns = timing_cycles_to_ns(timing_cycles_get(&red_start_time, &red_end_time));
		printk("Red led task time: %lld.%03lld ms\n", timing_ns / 1000000, timing_ns % 1000000 / 1000);
		add_sequence_time(timing_ns);

	}
}

void yellow_led_task(void *, void *, void *)
{
	printk("Yellow led thread started\n");
	while (true) {
		k_sem_take(&yellow_sem, K_FOREVER);
		timing_start();
		timing_t yellow_start_time = timing_counter_get();
		gpio_pin_set_dt(&red, 1);
		gpio_pin_set_dt(&green, 1);
		printk("Yellow on\n");
		k_sleep(K_SECONDS(1));

		gpio_pin_set_dt(&red, 0);
		gpio_pin_set_dt(&green, 0);
		printk("Yellow off\n");
		k_sem_give(&done_sem); 

		timing_t yellow_end_time = timing_counter_get();
		timing_stop();
		uint64_t timing_ns = timing_cycles_to_ns(timing_cycles_get(&yellow_start_time, &yellow_end_time));
		printk("Yellow led task time: %lld.%03lld ms\n", timing_ns / 1000000, timing_ns % 1000000 / 1000);
		add_sequence_time(timing_ns);
	}
}

void green_led_task(void *, void *, void *)
{
	printk("Green led thread started\n");
	while (true) {
		k_sem_take(&green_sem, K_FOREVER);
		timing_start();
		timing_t green_start_time = timing_counter_get();
		gpio_pin_set_dt(&green, 1);
		printk("Green on\n");
		k_sleep(K_SECONDS(1));

		gpio_pin_set_dt(&green, 0);
		printk("Green off\n");
		k_sem_give(&done_sem); 
		timing_t green_end_time = timing_counter_get();
		timing_stop();
		uint64_t timing_ns = timing_cycles_to_ns(timing_cycles_get(&green_start_time, &green_end_time));
		printk("Green led task time: %lld.%03lld ms\n", timing_ns / 1000000, timing_ns % 1000000 / 1000);
		add_sequence_time(timing_ns);
	}
}



int main(void)
{
    printk("HELLO UART\n");

    timing_init();
    timing_start();
    timing_t start_time = timing_counter_get();

    init_led();

    printk("MAIN RUNNING\n");

    if (init_uart() != 0) {
        printk("UART INIT FAILED\n");
        return 1;
    }

	k_sem_give(&red_sem);
    timing_t end_time = timing_counter_get();
    timing_stop();

    uint64_t timing_ns =
        timing_cycles_to_ns(
            timing_cycles_get(&start_time, &end_time));

    printk("Initialization time: %lld.%03lld ms\n",
           timing_ns / 1000000,
           timing_ns % 1000000 / 1000);

    return 0;
}
```

## src/TestSuite.cpp
```c
#include <gtest/gtest.h>
#include "TimeParser.h"

TEST(TimeParserTest, CorrectTime)
{
    char time_test[] = "000120";

    ASSERT_EQ(time_parse(time_test), 80);
}

TEST(TimeParserTest, NullPointer)
{
    ASSERT_EQ(time_parse(nullptr),
              TIME_ARRAY_ERROR);
}

TEST(TimeParserTest, WrongLength)
{
    char time_test[] = "123";

    ASSERT_EQ(time_parse(time_test),
              TIME_LEN_ERROR);
}

TEST(TimeParserTest, InvalidHour)
{
    char time_test[] = "240000";

    ASSERT_EQ(time_parse(time_test),
              TIME_VALUE_ERROR);
}

TEST(TimeParserTest, InvalidMinute)
{
    char time_test[] = "006000";

    ASSERT_EQ(time_parse(time_test),
              TIME_VALUE_ERROR);
}

TEST(TimeParserTest, InvalidSecond)
{
    char time_test[] = "000060";

    ASSERT_EQ(time_parse(time_test),
              TIME_VALUE_ERROR);
}

TEST(TimeParserTest, ContainsLetters)
{
    char time_test[] = "12AB34";

    ASSERT_EQ(time_parse(time_test),
              TIME_NOT_DIGIT_ERROR);
}

TEST(TimeParserTest, ZeroTime)
{
    char time_test[] = "000000";

    ASSERT_EQ(time_parse(time_test),
              TIME_ZERO_ERROR);
}
```

## src/TimeParser.cpp
```c
#include <stdlib.h>
#include <string.h>
#include <ctype.h>

#include "TimeParser.h"

int time_parse(char *time)
{
    int seconds = TIME_LEN_ERROR;

    if (time == NULL) {
        return TIME_ARRAY_ERROR;
    }

    if (strlen(time) != 6) {
        return TIME_LEN_ERROR;
    }

    for (int i = 0; i < 6; i++) {
        if (!isdigit(time[i])) {
            return TIME_NOT_DIGIT_ERROR;
        }
    }

    int values[3];

    values[2] = atoi(time + 4);
    time[4] = 0;

    values[1] = atoi(time + 2);
    time[2] = 0;

    values[0] = atoi(time);

    if (values[0] < 0 || values[0] > 23 ||
        values[1] < 0 || values[1] > 59 ||
        values[2] < 0 || values[2] > 59)
    {
        return TIME_VALUE_ERROR;
    }

    seconds =
        values[0] * 3600 +
        values[1] * 60 +
        values[2];

    if (seconds == 0) {
        return TIME_ZERO_ERROR;
    }

    return seconds;
}
```

## src/TimeParser.h
```c
#ifndef TIMEPARSER_H
#define TIMEPARSER_H

#define TIME_LEN_ERROR       -1
#define TIME_ARRAY_ERROR     -2
#define TIME_VALUE_ERROR     -3

#define TIME_NOT_DIGIT_ERROR -4
#define TIME_ZERO_ERROR      -5

int time_parse(char *time);

#endif
```

## src/main2p.c
```c
#include <zephyr/kernel.h>
#include <zephyr/sys/printk.h>
#include <zephyr/device.h>
#include <zephyr/drivers/gpio.h>
#include <errno.h>

/*
 * 2p suoritus:
 * - Punainen, keltainen ja vihreä liikennevalo
 * Tekijät: Henric M. ja Jere K.
 */

static const struct gpio_dt_spec red =
    GPIO_DT_SPEC_GET(DT_ALIAS(led0), gpios);

static const struct gpio_dt_spec green =
    GPIO_DT_SPEC_GET(DT_ALIAS(led1), gpios);

static const struct gpio_dt_spec blue =
    GPIO_DT_SPEC_GET(DT_ALIAS(led2), gpios);

static const struct gpio_dt_spec button =
    GPIO_DT_SPEC_GET(DT_ALIAS(sw4), gpios);

static struct gpio_callback button_cb_data;

#define STACKSIZE 500
#define PRIORITY 5

void red_led_task(void *, void *, void *);
void yellow_led_task(void *, void *, void *);
void green_led_task(void *, void *, void *);


K_THREAD_DEFINE(
    red_thread,
    STACKSIZE,
    red_led_task,
    NULL,
    NULL,
    NULL,
    PRIORITY,
    0,
    0
);

K_THREAD_DEFINE(
    yellow_thread,
    STACKSIZE,
    yellow_led_task,
    NULL,
    NULL,
    NULL,
    PRIORITY,
    0,
    0
);

K_THREAD_DEFINE(
    green_thread,
    STACKSIZE,
    green_led_task,
    NULL,
    NULL,
    NULL,
    PRIORITY,
    0,
    0
);

volatile int led_state = 0;

/* Tila ennen pausea */
volatile int previous_led_state = 0;

int init_led(void)
{
    int ret;

    ret = gpio_pin_configure_dt(&red, GPIO_OUTPUT_INACTIVE);

    if (ret < 0) {
        printk("Error: Red LED configure failed\n");
        return ret;
    }

    ret = gpio_pin_configure_dt(&green, GPIO_OUTPUT_INACTIVE);

    if (ret < 0) {
        printk("Error: Green LED configure failed\n");
        return ret;
    }

    ret = gpio_pin_configure_dt(&blue, GPIO_OUTPUT_INACTIVE);

    if (ret < 0) {
        printk("Error: Blue LED configure failed\n");
        return ret;
    }

    /* Kaikki LEDit aluksi pois */

    gpio_pin_set_dt(&red, 0);
    gpio_pin_set_dt(&green, 0);
    gpio_pin_set_dt(&blue, 0);

    printk("LEDs initialized OK\n");

    return 0;
}

void button_0_handler(
    const struct device *dev,
    struct gpio_callback *cb,
    uint32_t pins)
{
    ARG_UNUSED(dev);
    ARG_UNUSED(cb);
    ARG_UNUSED(pins);

    printk("Play/Pause pressed\n");
    
    if (led_state != 4) {

        previous_led_state = led_state;

        led_state = 4;

        printk("Traffic lights PAUSED\n");
    }

    else {

        led_state = previous_led_state;

        printk("Traffic lights RESUMED\n");
    }
}

int init_button(void)
{
    int ret;

    if (!gpio_is_ready_dt(&button)) {

        printk("Error: Button device is not ready\n");

        return -ENODEV;
    }

    ret = gpio_pin_configure_dt(
        &button,
        GPIO_INPUT
    );

    if (ret < 0) {

        printk("Error: Button configure failed\n");

        return ret;
    }

    ret = gpio_pin_interrupt_configure_dt(
        &button,
        GPIO_INT_EDGE_TO_ACTIVE
    );

    if (ret < 0) {

        printk("Error: Button interrupt configure failed\n");

        return ret;
    }

    gpio_init_callback(
        &button_cb_data,
        button_0_handler,
        BIT(button.pin)
    );

    ret = gpio_add_callback(
        button.port,
        &button_cb_data
    );

    if (ret < 0) {

        printk("Error: Button callback failed\n");

        return ret;
    }

    printk("Play/Pause button initialized OK\n");

    return 0;
}

void red_led_task(void *, void *, void *)
{
    printk("Red LED thread started\n");

    while (true) {

        if (led_state == 0) {

            gpio_pin_set_dt(&red, 1);
            gpio_pin_set_dt(&green, 0);
            gpio_pin_set_dt(&blue, 0);

            printk("RED ON\n");

            k_sleep(K_SECONDS(1));

            if (led_state == 0) {

                gpio_pin_set_dt(&red, 0);

                printk("RED OFF\n");

                k_sleep(K_SECONDS(1));

                if (led_state == 0) {

                    led_state = 1;
                }
            }
        }

        k_yield();
    }
}

void yellow_led_task(void *, void *, void *)
{
    printk("Yellow LED thread started\n");

    while (true) {

        if (led_state == 1) {

            gpio_pin_set_dt(&red, 1);
            gpio_pin_set_dt(&green, 1);
            gpio_pin_set_dt(&blue, 0);

            printk("YELLOW ON\n");

            k_sleep(K_SECONDS(1));

            if (led_state == 1) {

                gpio_pin_set_dt(&red, 0);
                gpio_pin_set_dt(&green, 0);

                printk("YELLOW OFF\n");

                k_sleep(K_SECONDS(1));

                if (led_state == 1) {

                    led_state = 2;
                }
            }
        }

        k_yield();
    }
}

void green_led_task(void *, void *, void *)
{
    printk("Green LED thread started\n");

    while (true) {

        if (led_state == 2) {

            gpio_pin_set_dt(&red, 0);
            gpio_pin_set_dt(&green, 1);
            gpio_pin_set_dt(&blue, 0);

            printk("GREEN ON\n");

            k_sleep(K_SECONDS(1));

            if (led_state == 2) {

                gpio_pin_set_dt(&green, 0);

                printk("GREEN OFF\n");

                k_sleep(K_SECONDS(1));

                if (led_state == 2) {

                    led_state = 0;
                }
            }
        }

        k_yield();
    }
}

int main(void)
{
    int ret;

    ret = init_led();

    if (ret < 0) {

        printk("LED initialization failed\n");

        return ret;
    }

    ret = init_button();

    if (ret < 0) {

        printk("Button initialization failed\n");

        return ret;
    }

    printk("--------------------------------\n");
    printk("Traffic light program started\n");
    printk("Button 1 = Play/Pause\n");
    printk("Press Play/Pause to pause/resume\n");
    printk("--------------------------------\n");

    return 0;
}
```

## src/main3p.c
```c
#include <zephyr/kernel.h>
#include <zephyr/sys/printk.h>
#include <zephyr/device.h>
#include <zephyr/drivers/gpio.h>
#include <zephyr/drivers/uart.h>
#include <zephyr/timing/timing.h>
#include <stdio.h>

/*
 * Viikko 3 - 3p suoritus
 * Tekijät: Henric M. ja Jere K.
 */

#define STACKSIZE 500
#define PRIORITY 5
#define DEBUG_PRIORITY 6

#define UART_DEVICE_NODE DT_CHOSEN(zephyr_shell_uart)
#define DEBUG

static const struct gpio_dt_spec red =
    GPIO_DT_SPEC_GET(DT_ALIAS(led0), gpios);

static const struct gpio_dt_spec green =
    GPIO_DT_SPEC_GET(DT_ALIAS(led1), gpios);

static const struct gpio_dt_spec blue =
    GPIO_DT_SPEC_GET(DT_ALIAS(led2), gpios);

static const struct device *const uart_dev =
    DEVICE_DT_GET(UART_DEVICE_NODE);

void red_led_task(void *, void *, void *);
void yellow_led_task(void *, void *, void *);
void green_led_task(void *, void *, void *);

static void uart_task(void *, void *, void *);
static void dispatcher_task(void *, void *, void *);
static void debug_task(void *, void *, void *);

K_THREAD_DEFINE(
    red_thread,
    STACKSIZE,
    red_led_task,
    NULL, NULL, NULL,
    PRIORITY,
    0,
    0
);

K_THREAD_DEFINE(
    yellow_thread,
    STACKSIZE,
    yellow_led_task,
    NULL, NULL, NULL,
    PRIORITY,
    0,
    0
);

K_THREAD_DEFINE(
    green_thread,
    STACKSIZE,
    green_led_task,
    NULL, NULL, NULL,
    PRIORITY,
    0,
    0
);

K_THREAD_DEFINE(
    uart_thread,
    STACKSIZE,
    uart_task,
    NULL, NULL, NULL,
    PRIORITY,
    0,
    0
);

K_THREAD_DEFINE(
    dispatcher_thread,
    STACKSIZE,
    dispatcher_task,
    NULL, NULL, NULL,
    PRIORITY,
    0,
    0
);

K_THREAD_DEFINE(
    debug_thread,
    STACKSIZE,
    debug_task,
    NULL, NULL, NULL,
    DEBUG_PRIORITY,
    0,
    0
);

K_SEM_DEFINE(red_sem, 0, 1);
K_SEM_DEFINE(yellow_sem, 0, 1);
K_SEM_DEFINE(green_sem, 0, 1);

K_SEM_DEFINE(done_sem, 0, 1);

K_FIFO_DEFINE(data_fifo);

K_FIFO_DEFINE(debug_fifo);

struct data_t {
    void *fifo_reserved;
    char color;
};

struct debug_data_t {
    void *fifo_reserved;
    char message[64];
};

static uint64_t sequence_total = 0;

void debug_print(const char *message)
{
#ifdef DEBUG

    struct debug_data_t *data =
        k_malloc(sizeof(struct debug_data_t));

    if (data == NULL) {
        return;
    }

    snprintf(
        data->message,
        sizeof(data->message),
        "%s",
        message
    );

    k_fifo_put(&debug_fifo, data);

#endif
}

int init_uart(void)
{
    if (!device_is_ready(uart_dev)) {
        return 1;
    }

    return 0;
}

int init_led(void)
{
    int ret;

    ret = gpio_pin_configure_dt(
        &red,
        GPIO_OUTPUT_ACTIVE
    );

    if (ret < 0) {
        printk("Error: Red LED configure failed\n");
        return ret;
    }

    ret = gpio_pin_configure_dt(
        &green,
        GPIO_OUTPUT_ACTIVE
    );

    if (ret < 0) {
        printk("Error: Green LED configure failed\n");
        return ret;
    }

    ret = gpio_pin_configure_dt(
        &blue,
        GPIO_OUTPUT_ACTIVE
    );

    if (ret < 0) {
        printk("Error: Blue LED configure failed\n");
        return ret;
    }

    gpio_pin_set_dt(&red, 0);
    gpio_pin_set_dt(&green, 0);
    gpio_pin_set_dt(&blue, 0);

    printk("LED initialized ok\n");

    return 0;
}

void add_sequence_time(uint64_t task_ns)
{
    sequence_total += task_ns;
}

void print_sequence_time(void)
{
    uint64_t total_us =
        sequence_total / 1000;

    char message[64];

    snprintf(
        message,
        sizeof(message),
        "Total sequence time: %lld us",
        total_us
    );

    debug_print(message);

    sequence_total = 0;
}

static void debug_task(void *, void *, void *)
{
    struct debug_data_t *data;

    printk("Debug thread started\n");

    while (true) {

        data = k_fifo_get(
            &debug_fifo,
            K_FOREVER
        );

        if (data != NULL) {

            printk(
                "%s\n",
                data->message
            );

            k_free(data);
        }
    }
}

static void uart_task(void *, void *, void *)
{
    char c = 0;

    debug_print("UART thread started");

    while (true) {

        if (uart_poll_in(
                uart_dev,
                &c) == 0) {

            if (c == 'R' ||
                c == 'Y' ||
                c == 'G') {

                timing_start();

                timing_t uart_start_time =
                    timing_counter_get();

                struct data_t *data =
                    k_malloc(
                        sizeof(struct data_t)
                    );

                if (data == NULL) {

                    debug_print(
                        "Malloc failed"
                    );

                    timing_t uart_end_time =
                        timing_counter_get();

                    timing_stop();

                    continue;
                }

                data->color = c;

                k_fifo_put(
                    &data_fifo,
                    data
                );

                timing_t uart_end_time =
                    timing_counter_get();

                timing_stop();

                uint64_t uart_ns =
                    timing_cycles_to_ns(
                        timing_cycles_get(
                            &uart_start_time,
                            &uart_end_time
                        )
                    );

                uint64_t uart_us =
                    uart_ns / 1000;

                char message[64];

                snprintf(
                    message,
                    sizeof(message),
                    "UART processing time: %lld us",
                    uart_us
                );

                debug_print(message);

#ifdef DEBUG

                snprintf(
                    message,
                    sizeof(message),
                    "Data sent to FIFO: %c",
                    c
                );

                debug_print(message);

#endif
            }
        }

        k_msleep(10);
    }
}

static void dispatcher_task(void *, void *, void *)
{
    debug_print("Dispatcher thread started");

    while (true) {

        struct data_t *data =
            k_fifo_get(
                &data_fifo,
                K_FOREVER
            );

        if (data != NULL) {

            timing_start();

            timing_t dispatcher_start_time =
                timing_counter_get();

#ifdef DEBUG

            char message[64];

            snprintf(
                message,
                sizeof(message),
                "Dispatcher received: %c",
                data->color
            );

            debug_print(message);

#endif

            switch (data->color) {

                case 'R':
                    k_sem_give(&red_sem);
                    break;

                case 'Y':
                    k_sem_give(&yellow_sem);
                    break;

                case 'G':
                    k_sem_give(&green_sem);
                    break;

                default:
                    break;
            }

            k_free(data);

            timing_t dispatcher_end_time =
                timing_counter_get();

            timing_stop();

            uint64_t dispatcher_ns =
                timing_cycles_to_ns(
                    timing_cycles_get(
                        &dispatcher_start_time,
                        &dispatcher_end_time
                    )
                );

            uint64_t dispatcher_us =
                dispatcher_ns / 1000;

            char message2[64];

            snprintf(
                message2,
                sizeof(message2),
                "Dispatcher processing time: %lld us",
                dispatcher_us
            );

            debug_print(message2);

            k_sem_take(
                &done_sem,
                K_FOREVER
            );

            if (k_fifo_is_empty(&data_fifo)) {
                print_sequence_time();
            }
        }
    }
}

void red_led_task(void *, void *, void *)
{
    debug_print("Red LED thread started");

    while (true) {

        k_sem_take(
            &red_sem,
            K_FOREVER
        );

        timing_start();

        timing_t red_start_time =
            timing_counter_get();

        gpio_pin_set_dt(&red, 1);

        debug_print("Red ON");

        k_sleep(K_SECONDS(1));

        gpio_pin_set_dt(&red, 0);

        debug_print("Red OFF");

        timing_t red_end_time =
            timing_counter_get();

        timing_stop();

        uint64_t timing_ns =
            timing_cycles_to_ns(
                timing_cycles_get(
                    &red_start_time,
                    &red_end_time
                )
            );

        uint64_t timing_us =
            timing_ns / 1000;

        add_sequence_time(timing_ns);

        char message[64];

        snprintf(
            message,
            sizeof(message),
            "Red LED task time: %lld us",
            timing_us
        );

        debug_print(message);

        k_sem_give(&done_sem);
    }
}

void yellow_led_task(void *, void *, void *)
{
    debug_print("Yellow LED thread started");

    while (true) {

        k_sem_take(
            &yellow_sem,
            K_FOREVER
        );

        timing_start();

        timing_t yellow_start_time =
            timing_counter_get();

        gpio_pin_set_dt(&red, 1);
        gpio_pin_set_dt(&green, 1);

        debug_print("Yellow ON");

        k_sleep(K_SECONDS(1));

        gpio_pin_set_dt(&red, 0);
        gpio_pin_set_dt(&green, 0);

        debug_print("Yellow OFF");

        timing_t yellow_end_time =
            timing_counter_get();

        timing_stop();

        uint64_t timing_ns =
            timing_cycles_to_ns(
                timing_cycles_get(
                    &yellow_start_time,
                    &yellow_end_time
                )
            );

        uint64_t timing_us =
            timing_ns / 1000;

        add_sequence_time(timing_ns);

        char message[64];

        snprintf(
            message,
            sizeof(message),
            "Yellow LED task time: %lld us",
            timing_us
        );

        debug_print(message);

        k_sem_give(&done_sem);
    }
}

void green_led_task(void *, void *, void *)
{
    debug_print("Green LED thread started");

    while (true) {

        k_sem_take(
            &green_sem,
            K_FOREVER
        );

        timing_start();

        timing_t green_start_time =
            timing_counter_get();

        gpio_pin_set_dt(&green, 1);

        debug_print("Green ON");

        k_sleep(K_SECONDS(1));

        gpio_pin_set_dt(&green, 0);

        debug_print("Green OFF");

        timing_t green_end_time =
            timing_counter_get();

        timing_stop();

        uint64_t timing_ns =
            timing_cycles_to_ns(
                timing_cycles_get(
                    &green_start_time,
                    &green_end_time
                )
            );

        uint64_t timing_us =
            timing_ns / 1000;

        add_sequence_time(timing_ns);

        char message[64];

        snprintf(
            message,
            sizeof(message),
            "Green LED task time: %lld us",
            timing_us
        );

        debug_print(message);

        k_sem_give(&done_sem);
    }
}

int main(void)
{
    timing_init();

    timing_start();

    timing_t start_time =
        timing_counter_get();

    if (init_led() != 0) {

        printk("LED INIT FAILED\n");

        return 1;
    }

    if (init_uart() != 0) {

        printk("UART INIT FAILED\n");

        return 1;
    }

    timing_t end_time =
        timing_counter_get();

    timing_stop();

    uint64_t timing_ns =
        timing_cycles_to_ns(
            timing_cycles_get(
                &start_time,
                &end_time
            )
        );

    uint64_t timing_us =
        timing_ns / 1000;

    printk(
        "Initialization time: %lld us\n",
        timing_us
    );

    while (true) {
        k_msleep(1000);
    }

    return 0;
}
```
